## drivers/boardinfo/Kconfig
```kconfig
#
# boardinfo drivers
#
# When adding new entries keep the list in alphabetical order

config BOARDINFO
	tristate "tinker boardinfo"
	default y
	help
	  Driver to set board information.
```

## drivers/char/rockchip/Kconfig
```kconfig
#
# Rockchip char driver config
#

menuconfig RK_CHAR_DRIVERS
	bool "Rockchip Char Drivers"
	help
	  Rockchip's char drivers

config RK3288_DEVGPIOMEM
	tristate "/dev/gpiomem rootless GPIO access via mmap() on the RK3288"
	default y
	help
		Provides users with root-free access to the GPIO registers
		on the 3288. Calling mmap(/dev/gpiomem) will map the GPIO
		register page to the user's pointer.
```

## drivers/gpu/drm/bridge/sn65dsi8x/Kconfig
```kconfig
config DRM_I2C_SN65DSI84
	tristate "SN65DSI84"
	depends on OF
	select DRM_KMS_HELPER
	select REGMAP_I2C
	help
	  Support for the TI SN65DSI84.
```

## drivers/media/i2c/soc_camera/rockchip/Kconfig
```kconfig
config VIDEO_OV8858
	tristate "ov8858 driver adapt to rockchip cif isp platform"
	depends on VIDEO_V4L2 && VIDEO_RK_CIF_ISP10 && I2C
	default n
	---help---
	This is ov8858 camera driver adapt to rockchip cif isp platform.
config VIDEO_IMX219
	tristate "imx219 driver adapt to rockchip cif isp platform"
	depends on VIDEO_V4L2 && VIDEO_RK_CIF_ISP10 && I2C
	default n
	---help---
	This is imx219 camera driver adapt to rockchip cif isp platform.
```

## sound/soc/bcm/Kconfig
```kconfig
config SND_BCM2835_SOC_I2S
	tristate "SoC Audio support for the Broadcom BCM2835 I2S module"
	depends on ARCH_BCM2835 || COMPILE_TEST
	select SND_SOC_GENERIC_DMAENGINE_PCM
	select REGMAP_MMIO
	help
	  Say Y or M if you want to add support for codecs attached to
	  the BCM2835 I2S interface. You will also need
	  to select the audio interfaces to support below.

config SND_AUDIOINJECTOR_OCTO_SOUNDCARD
	tristate "Support for audioinjector.net Octo channel (Hat) soundcard"
	depends on SND_BCM2708_SOC_I2S || SND_BCM2835_SOC_I2S
	select SND_SOC_CS42XX8_I2C
	help
	  Say Y or M if you want to add support for audioinjector.net octo add on
```
