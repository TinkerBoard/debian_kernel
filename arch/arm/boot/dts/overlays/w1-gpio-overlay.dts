/dts-v1/;
/plugin/;

/ {
    compatible = "rockchip,rk3288-miniarm", "rockchip,rk3288";
    fragment@0 {
        target-path = "/";
        __overlay__ {
            w1: onewire@0 {
                compatible = "w1-gpio";
                pinctrl-names = "default";
                pinctrl-0 = <&w1_pins>;
                gpios = <&gpio0 17 0>;
                status = "okay";
            };
        };
    };

    fragment@1 {
        target = <&gpio0>;
        __overlay__ {
            w1_pins: w1_pins@0 {
                rockchip,pins = <0 17 0 &pcfg_pull_up>;
            };
        };
    };
};
