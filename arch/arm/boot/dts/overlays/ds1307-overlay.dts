// Definitions for ds1307
/dts-v1/;
/plugin/;

/ {
	compatible = "rockchip,rk3288-miniarm", "rockchip,rk3288";

	fragment@0 {
		target = <&i2c1>;
		__overlay__ {
			rtc: ds1307@68 {
				compatible = "dallas,ds1307";
				status = "okay";
			};
		};
	};
};
